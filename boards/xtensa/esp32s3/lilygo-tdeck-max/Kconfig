## boards/xtensa/esp32s3/lilygo-tdeck-max/Kconfig
```kconfig
#
# For a description of the syntax of this configuration file,
# see the file kconfig-language.txt in the NuttX tools repository.
#

if ARCH_BOARD_LILYGO_TDECK_MAX

config LILYGO_TDECK_MAX_XL9555_FREQUENCY
	int "XL9555 I2C frequency (Hz)"
	default 400000
	depends on IOEXPANDER_PCA9555
	---help---
		I2C bus frequency used to talk to the XL9555 I/O expander, which
		gates the power of most peripherals on the T-Deck Max.

config LILYGO_TDECK_MAX_POWERKEY
	bool "Side button as a power key (/dev/kbd2)"
	default n
	depends on INPUT_KEYBOARD && ESPRESSIF_GPIO_IRQ && SCHED_LPWORK
	---help---
		Register the side button on GPIO0 (S2, "BOOT") as a one-key
		keyboard, /dev/kbd2, reporting KEYCODE_POWER.  The other side
		button, S1, resets the chip.

config LILYGO_TDECK_MAX_MODEM_SLEEP
	bool "Light sleep with the modem on (RI, DTR, /dev/awake)"
	default n
	depends on ESP32S3_AUTO_SLEEP && ESPRESSIF_GPIO_IRQ && SCHED_LPWORK
	---help---
		Let the chip sleep while the modem is on: the modem's ring
		indicator (GPIO7) wakes it, /dev/modem_sleep counts the pulses
		and drives DTR (GPIO8, for the modem's own sleep), and
		/dev/awake keeps the chip awake while it is open, for modemd to
		hold while it talks to the modem.  Without it the chip stays
		awake whenever the modem's rail is on.

config LILYGO_TDECK_MAX_TCA8418_FREQUENCY
	int "TCA8418 I2C frequency (Hz)"
	default 400000
	depends on INPUT_TCA8418
	---help---
		I2C bus frequency used to talk to the TCA8418, the scanner behind
		the T-Deck Max keyboard.

config LILYGO_TDECK_MAX_BATTERY_CAPACITY
	int "Battery design capacity (mAh)"
	default 1400
	range 0 32767
	depends on BQ27220
	---help---
		The capacity of the cell, which the BQ27220 fuel gauge needs to
		turn charge into a percentage.  The T-Deck Max ships with a
		1400 mAh cell.  The gauge keeps the value in RAM for as long as
		the cell powers it, so it is written at boot only when it differs,
		which takes a couple of seconds.  0 leaves the gauge alone.

config LILYGO_TDECK_MAX_CHARGE_VOLTAGE
	int "Battery charge voltage (mV)"
	default 4288
	range 3840 4608
	depends on SY6970
	---help---
		The voltage the SY6970 charges the cell to, in steps of 16 mV.
		4288 is what the vendor's firmware sets.  A cell rated for 4.20 V
		is charged more gently at 4208, the charger's own default, for a
		few percent less capacity.

config LILYGO_TDECK_MAX_CHARGE_CURRENT
	int "Battery charge current (mA)"
	default 1024
	range 64 5056
	depends on SY6970
	---help---
		The fast charge current, in steps of 64 mA.  1024 is what the
		vendor's firmware sets, about 0.7 C for the 1400 mAh cell.  It is
		applied at every boot because the charger forgets it whenever the
		battery is disconnected.

config LILYGO_TDECK_MAX_BOOT_LORA_POWER
	bool "Power the SX1262 LoRa module at boot, asleep"
	default y
	depends on IOEXPANDER_PCA9555
	---help---
		Power the LoRa rail (XL9555 P01) at boot and put the SX1262 into
		its sleep mode, where it draws well under a microamp.

		That is cheaper than switching the rail off.  The SX1262 shares
		the SPI bus with the e-paper and the microSD card, and with its
		rail off it is fed through the bus lines instead: about 15 mA
		through its chip select, which idles high.  Holding the chip
		select low avoids that but lets the unpowered chip load the bus,
		and the e-paper stops working.

		The rail can still be switched at runtime through /dev/lora_en.

config LILYGO_TDECK_MAX_BOOT_GPS_POWER
	bool "Power the MIA-M10Q GPS module at boot"
	default n
	depends on IOEXPANDER_PCA9555
	---help---
		The GPS rail (XL9555 P02) is left off by default to save power.
		The rail can also be switched at runtime through /dev/gps_en.

config LILYGO_TDECK_MAX_BOOT_WIFI
	bool "Bring up Wi-Fi at boot"
	default n
	depends on ESPRESSIF_WIFI
	---help---
		Wi-Fi is left uninitialised by default.  Initialising it takes a
		large part of the internal heap, and the network stack starts the
		radio when it brings wlan0 up, so an idle handheld would otherwise
		keep it running for nothing.

		It can be brought up at runtime instead:

		    gpio -o 1 /dev/wifi_en
		    ifup wlan0

		There is no way to take it down again short of a reset, although
		ifdown and ifup stop and start the radio once it is up.

		Bringing it up at boot needs BOARD_INITTHREAD_STACKSIZE of at
		least 4096.  Anything smaller is refused at build time, because
		the failure is a silent reset loop.

config LILYGO_TDECK_MAX_BOOT_BLE
	bool "Bring up Bluetooth LE at boot"
	default n
	depends on ESPRESSIF_BLE
	---help---
		BLE is left uninitialised by default: bringing it up enables the
		controller, which stays enabled.

		It can be brought up at runtime instead:

		    gpio -o 1 /dev/ble_en
		    ifup bnep0

		There is no way to take it down again short of a reset.

config LILYGO_TDECK_MAX_BOOT_TERMINAL
	bool "Start the on-device terminal at boot"
	default y
	depends on EXAMPLES_NXTERM && SYSTEM_NXINIT
	---help---
		Start nxterm at boot, as an NxInit service, so that the e-paper
		and the keyboard work as a terminal without a computer attached.
		The USB console is unaffected and runs its own shell.

		nxterm's start-up messages are discarded.  If the screen stays
		blank, disable this and run nxterm by hand from the USB console to
		see them.

		The terminal is started once.  Typing exit on the device ends it
		until the next reset: nxterm does not tidy up after its shell, so
		it cannot simply be restarted.

config LILYGO_TDECK_MAX_OPT
	bool "Mount /opt, the flash for installed apps"
	default n
	depends on ESP32S3_SPIFLASH && ESP32S3_SPIFLASH_LITTLEFS
	---help---
		A littlefs in the flash between the second firmware slot and
		the settings partition, mounted at /opt: where pnut-os's pkgd
		installs apps.  It is formatted on first use.

if LILYGO_TDECK_MAX_OPT

config LILYGO_TDECK_MAX_OPT_OFFSET
	hex "/opt's offset in the flash"
	default 0x800000

config LILYGO_TDECK_MAX_OPT_SIZE
	hex "/opt's size"
	default 0x700000

endif

endif # ARCH_BOARD_LILYGO_TDECK_MAX
```
